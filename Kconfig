## drivers/sensor/mt6701/Kconfig
```kconfig
# Copyright (c) 2025 Marcin Bober
# SPDX-License-Identifier: Apache-2.0

menuconfig MT6701
	bool "MT6701 Differential Hall magnetic angle encoder"
	default y
	depends on DT_HAS_NOVOSENSE_MT6701_ENABLED
	select SPI
	select RTIO_WORKQ if SENSOR_ASYNC_API
	help
	  Enable driver for MT6701 Differential Hall magnetic angle encoder.

if MT6701

config MT6701_STREAM
	bool "Use FIFO to stream data"
	default y
	depends on SPI_RTIO
	depends on SENSOR_ASYNC_API
	help
	  Use this configuration option to enable streaming sensor data via RTIO.

config MT6701_ENABLE_CRC
	bool "Use CRC"
	default n
	help
	  Use this config option to enable CRC calculation. This requires 2 more bytes to be transferred and more processing power.

config MT6701_ENABLE_LAG
	bool "Enable smoothing"
	default n
	help
	  Use this config option to enable velocity data smoothing.

if MT6701_ENABLE_LAG
config MT6701_LAG_VALUE
	int "Smoothing value"
	default 1000
	help
	  Set how much you want to smooth the velocity result.
endif # MT6701_ENABLE_LAG

endif # MT6701
```

## dts/bindings/sensor/novosense,mt6701.yaml
```yaml
# Copyright (c) 2022, Marcin Bober
# SPDX-License-Identifier: Apache-2.0

description: |
    Novosense MT6701 Differential Hall magnetic angle encoder

compatible: "novosense,mt6701"

include: [sensor-device.yaml, spi-device.yaml]
```
